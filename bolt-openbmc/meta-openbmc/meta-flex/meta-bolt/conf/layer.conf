## bolt-openbmc/meta-openbmc/meta-flex/meta-bolt/conf/layer.conf
```bitbake
# We have a conf and classes directory, add to BBPATH
BBPATH .= ":${LAYERDIR}"

# We have recipes-* directories, add to BBFILES
BBFILES += "${LAYERDIR}/recipes-*/*/*.bb \
	${LAYERDIR}/recipes-*/*/*.bbappend"

BBFILE_COLLECTIONS += "bolt"
BBFILE_PATTERN_bolt = "^${LAYERDIR}/"
BBFILE_PRIORITY_bolt = "25"
```

## bolt-openbmc/meta-openbmc/meta-flex/meta-bolt/conf/local.conf
```bitbake
#
# Local configuration file for building the OpenBMC image.
#

# Machine Selection
# Flex use wedge100 for bolt switch, no new meta layers created for bolt switch
MACHINE ??= "wedge100"

# OpenBMC distro settings
DISTRO ?= "openbmc-fb"
```

## bolt-openbmc/meta-openbmc/yocto/krogoth/meta-security/conf/layer.conf
```bitbake
# We have a conf and classes directory, add to BBPATH
BBPATH .= ":${LAYERDIR}"

# We have recipes-* directories, add to BBFILES
BBFILES += "${LAYERDIR}/recipes-*/*/*.bb \
	${LAYERDIR}/recipes-*/*/*.bbappend"

BBFILE_COLLECTIONS += "security"
BBFILE_PATTERN_security = "^${LAYERDIR}/"
BBFILE_PRIORITY_security = "6"

LAYERDEPENDS_security = "openembedded-layer perl-layer networking-layer"
```

## meta-openbmc/meta-linkedin/conf/layer.conf
```bitbake
# We have a conf and classes directory, add to BBPATH
BBPATH .= ":${LAYERDIR}"

# We have recipes-* directories, add to BBFILES
BBFILES += "${LAYERDIR}/recipes-*/*/*.bb \
	${LAYERDIR}/recipes-*/*/*.bbappend"

BBFILE_COLLECTIONS += "linkedin"
BBFILE_PATTERN_linkedin = "^${LAYERDIR}/"
BBFILE_PRIORITY_linkedin = "15"
```

## meta-openbmc/meta-linkedin/meta-deltapower/conf/layer.conf
```bitbake
# We have a conf and classes directory, add to BBPATH
BBPATH .= ":${LAYERDIR}"

# We have recipes-* directories, add to BBFILES
BBFILES += "${LAYERDIR}/recipes-*/*/*.bb \
	${LAYERDIR}/recipes-*/*/*.bbappend"

BBFILE_COLLECTIONS += "deltapower"
BBFILE_PATTERN_deltapower = "^${LAYERDIR}/"
BBFILE_PRIORITY_deltapower = "25"
```

## meta-openbmc/meta-linkedin/meta-lighting/conf/local.conf.sample
```bitbake
#
# Local configuration file for building the OpenBMC image.
#

# Machine Selection
MACHINE ??= "lighting"

# OpenBMC distro settings
DISTRO ?= "openbmc-fb"
```

## meta-openbmc/meta-linkedin/meta-lighting/conf/machine/lighting.conf
```bitbake
#@TYPE: Machine
#@NAME: lighting
#@DESCRIPTION: Machine configuration for Linked Lighting Power Shelf

require conf/machine/include/ast1250.inc

UBOOT_MACHINE_lighting = "lideltapower_config"

PREFERRED_VERSION_u-boot = "v2016.07"
PREFERRED_VERSION_u-boot-mkimage = "v2016.07"
PREFERRED_VERSION_u-boot-fw-utils = "v2016.07"

# configuration for preferred version of packages
PREFERRED_VERSION_rest-api = "0.2"
PREFERRED_VERSION_at93cx6-util = "0.1"
PREFERRED_VERSION_bcm5396-util = "0.1"
PREFERRED_VERSION_openbmc-gpio = "0.2"
PREFERRED_VERSION_kcsd = "0.2"
PREFERRED_VERSION_fscd = "0.3"

MACHINE_ESSENTIAL_EXTRA_RDEPENDS += "           \
    kernel-module-i2c-dev-sysfs                 \
    kernel-module-fancontrol                       \
    "
```

## meta-openbmc/meta-linkedin/meta-yellowsub/conf/machine/yellowsub.conf
```bitbake
#@TYPE: Machine
#@NAME: Yellowsub
#@DESCRIPTION: Machine configuration for LinkedIn Yellowsub

UBOOT_MACHINE_yellowsub = "liyellowsub_config"

PREFERRED_VERSION_u-boot = "v2016.07"
PREFERRED_VERSION_u-boot-mkimage = "v2016.07"
PREFERRED_VERSION_u-boot-fw-utils = "v2016.07"
PREFERRED_VERSION_linux-aspeed = "4.1.51"
PREFERRED_VERSION_fscd = "0.2"
PREFERRED_VERSION_fw-util = "0.1"

KERNEL_IMAGETYPE = "zImage"

require conf/machine/include/ast1250.inc

MACHINE_ESSENTIAL_EXTRA_RDEPENDS += "           \
    kernel-module-i2c-dev-sysfs                 \
    kernel-module-cpld                          \
    "
```
